/dts-v1/;
/plugin/;

/ {
    compatible = "brcm,bcm2835";

    fragment@0 {
        target = <&i2c1>;
        __overlay__ {
            status = "okay";
            #address-cells = <1>;
            #size-cells = <0>;
            
            bmp180: bmp180@77 {
                compatible = "bosch,bmp180";
                reg = <0x77>;
                status = "okay";
            };
        };
    };
};